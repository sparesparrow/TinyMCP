## west.yml
```yaml
# Copyright (c) 2025 Golioth, Inc.
# SPDX-License-Identifier: Apache-2.0

manifest:
  version: 1.0

  projects:
    - name: golioth
      path: modules/lib/golioth-firmware-sdk
      revision: v0.18.1
      url: https://github.com/golioth/golioth-firmware-sdk
      submodules: true
      import:
        file: west-zephyr.yml
        path-prefix: deps
        name-allowlist:
          - zephyr
          - cmsis
          - hal_espressif
          - hal_nordic
          - hal_nxp
          - mbedtls
          - mcuboot
          - net-tools
          - segger
          - tfm-mcuboot
          - tinycrypt
          - trusted-firmware-m
          - zcbor

  self:
    path: app
```
